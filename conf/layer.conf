## conf/layer.conf
```bitbake
# We have a conf and classes directory, add to BBPATH
BBPATH .= ":${LAYERDIR}"

# We have recipes-* directories, add to BBFILES
BBFILES += "${LAYERDIR}/recipes-*/*/*.bb \
            ${LAYERDIR}/recipes-*/*/*.bbappend"

BBFILE_COLLECTIONS += "meta-geektech"
BBFILE_PATTERN_meta-geektech = "^${LAYERDIR}/"
BBFILE_PRIORITY_meta-geektech = "6"

LAYERDEPENDS_meta-geektech = "core"
LAYERSERIES_COMPAT_meta-geektech = "honister"
```
